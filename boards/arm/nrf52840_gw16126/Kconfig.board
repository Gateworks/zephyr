## boards/arm/nrf52840_gw16126/Kconfig.board
```kconfig
# Kconfig - nRF52840 GW16126 board configuration
#
# Copyright (c) 2018 Gateworks Corporation
#
# SPDX-License-Identifier: Apache-2.0

config  BOARD_NRF52840_GW16126
	bool "NRF52840 GW16126"
	depends on SOC_NRF52840_QIAA
```

## boards/arm/nrf52840_gw16126/Kconfig.defconfig
```kconfig
# Kconfig - nRF52 GW16126 board configuration
#
# Copyright (c) 2018 Gateworks Corporation
#
# SPDX-License-Identifier: Apache-2.0

if BOARD_NRF52840_GW16126

config BOARD
	default "nrf52840_gw16126"

if USB

config USB_NRF52840
	def_bool y

config USB_DEVICE_STACK
	def_bool y

endif # USB

if IEEE802154

config IEEE802154_NRF5
	def_bool y

endif # IEEE802154

endif # BOARD_NRF52840_GW16126
```
